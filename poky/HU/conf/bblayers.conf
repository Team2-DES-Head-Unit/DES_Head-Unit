## poky/HU/conf/bblayers.conf
```bitbake
# POKY_BBLAYERS_CONF_VERSION is increased each time build/conf/bblayers.conf
# changes incompatibly
POKY_BBLAYERS_CONF_VERSION = "2"

BBPATH = "${TOPDIR}"
BBFILES ?= ""

BBLAYERS ?= " \
  /home/seame/poky/meta \
  /home/seame/poky/meta-poky \
  /home/seame/poky/meta-yocto-bsp \
  /home/seame/poky/meta-raspberrypi \
  /home/seame/poky/meta-openembedded/meta-oe \
  /home/seame/poky/meta-openembedded/meta-multimedia \
  /home/seame/poky/meta-openembedded/meta-networking \
  /home/seame/poky/meta-openembedded/meta-python \
  /home/seame/poky/meta-python2 \
  /home/seame/poky/meta-qt5 \
  /home/seame/poky/meta-HU \
  "
```

## poky/meta-vsomeip/conf/layer.conf
```bitbake
# We have a conf and classes directory, add to BBPATH
BBPATH .= ":${LAYERDIR}"

BBFILES += "${LAYERDIR}/recipes-*/*/*.bb \
            ${LAYERDIR}/recipes-*/*/*.bbappend \
            ${LAYERDIR}/recipes-*/*/*/*.bbappend \
	    "

BBFILE_COLLECTIONS += "vsomeip"
BBFILE_PATTERN_vsomeip = "^${LAYERDIR}/"
BBFILE_PRIORITY_vsomeip = "11"
LAYERSERIES_COMPAT_vsomeip = "kirkstone"
```
